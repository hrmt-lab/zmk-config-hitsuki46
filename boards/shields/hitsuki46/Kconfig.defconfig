## boards/shields/hitsuki46/Kconfig.defconfig
```kconfig
if SHIELD_HITSUKI46_DONGLE

config ZMK_KEYBOARD_NAME
    default "hitsuki46"

config ZMK_SPLIT
    default y

config ZMK_SPLIT_ROLE_CENTRAL
    default y

endif

if SHIELD_HITSUKI46_R

config ZMK_KEYBOARD_NAME
    default "hitsuki46_R"

config ZMK_SPLIT
    default y

endif

if SHIELD_HITSUKI46_L

config ZMK_KEYBOARD_NAME
    default "hitsuki46_L"

config ZMK_SPLIT
    default y

endif
```

## boards/shields/hitsuki46/Kconfig.shield
```kconfig
config SHIELD_HITSUKI46_DONGLE
    def_bool $(shields_list_contains,hitsuki46_dongle)

config SHIELD_HITSUKI46_R
    def_bool $(shields_list_contains,hitsuki46_R)

config SHIELD_HITSUKI46_L
    def_bool $(shields_list_contains,hitsuki46_L)
```
